## samba4/Config.in
```kconfig
config SAMBA4_SERVER_NETBIOS
	bool "enable Netbios support"
	depends on PACKAGE_samba4-server
	help
		installs: nmbd (daemon)
		Builds the nmbd to announce samba resources via netbios.
		NOTE: Windows 10 (1709+) will not display workgroup netbios resources anymore, unless the old SMB1 feature is reinstalled (not recommend).
		Therefor this feature can be safely disabled, network shares can still be directly accessed via network paths '\\hostname\sharename' and mounted via 'map network drive'.
	default n

config SAMBA4_SERVER_VFS
	bool "enable common VFS modules"
	depends on PACKAGE_samba4-server
	help
		provides commonly used vfs modules
		installs: 
			modules: (vfs_btrfs) vfs_fruit vfs_shadow_copy2 vfs_recycle vfs_fake_perms vfs_readonly vfs_cap vfs_offline vfs_crossrename
	default y

config SAMBA4_SERVER_VFSX
	bool "enable extended VFS modules"
	depends on PACKAGE_samba4-server
	help
		provides extra vfs modules
		installs: 
			modules: vfs_virusfilter vfs_shell_snap vfs_commit vfs_worm vfs_xattr_tdb vfs_streams_xattr vfs_aio_fork vfs_aio_pthread (vfs_linux_xfs_sgid) vfs_netatalk vfs_dirsort vfs_fileid vfs_catia
	default n

config SAMBA4_SERVER_AVAHI
	bool "enable AVAHI support (needs a AVAHI-daemon)"
	depends on PACKAGE_samba4-server
	select PACKAGE_libavahi-client
	help
		Supports AVAHI daemon to announce samba resources, via mDNS/SD.
	default n
	
config SAMBA4_SERVER_QUOTAS
	bool "enable QUOTAS support"
	depends on PACKAGE_samba4-server
	help
		installs:
			modules: vfs_default_quota
		Supports linux sysquotas or windows via the vfs_default_quota module.
	default n
	
config SAMBA4_SERVER_ACL
	bool "enable ACL support"
	depends on PACKAGE_samba4-server
	select PACKAGE_acl
	help
		installs: sharesec
			modules: vfs_acl_xattr vfs_acl_tdb vfs_posixacl
		Supports extended access control lists for windows, linux shares.
	default n

config SAMBA4_SERVER_AD_DC
	bool "enable AD-DC support (needs krb5-server) (EXPERIMENTAL)"
	depends on PACKAGE_samba4-server
	select PACKAGE_python-base
	select PACKAGE_python-crypto
	select PACKAGE_libopenssl
	select PACKAGE_libgnutls
	select PACKAGE_libopenldap
	help
		installs: samba (meta-daemon) python-crypt ntlm_auth
			scripts: samba-tool 
		see: https://wiki.samba.org/index.php/Setting_up_Samba_as_an_Active_Directory_Domain_Controller
		HINT: see section (# Using the Domain Controller as a File Server)
		NOTE: Extroot is recommend for this setup, since it is not optimized to run completely from ram/tempfs!
	default n

	config SAMBA4_SERVER_WINBIND
		bool "enable Winbind support"
		depends on PACKAGE_samba4-server
		depends on SAMBA4_SERVER_AD_DC
		help
			installs: winbindd (daemon) wbinfo
			The Winbindd service enables you to:
				Use domain users and groups in local commands, such as chown and chgrp.
				Display domain users and groups in local command's output, such as ls.
				see: https://wiki.samba.org/index.php/Configuring_Winbindd_on_a_Samba_AD_DC
		default n		
```
